## CMakeLists.txt
```
cmake_minimum_required(VERSION 3.20.0)

find_package(Zephyr REQUIRED HINTS $ENV{ZEPHYR_BASE})
project(motor_sim_demo)

target_sources(app PRIVATE
    src/main.c
    src/app_state.c
    src/motor_control.c
    src/telemetry.c
    src/fault_monitor.c
    src/console_shell.c
)
```

## west.yml
```
manifest:
  projects:
    - name: zephyr
      url: https://github.com/zephyrproject-rtos/zephyr
      revision: v4.3.0
      path: zephyr
      # This line enables extra `west` commands such as `west build`.
      west-commands: scripts/west-commands.yml

  self:
    path: motor-sim-demo
```

## prj.conf
```kconfig
# Kernel
CONFIG_MAIN_STACK_SIZE=2048
CONFIG_SYSTEM_WORKQUEUE_STACK_SIZE=2048
CONFIG_KERNEL_BIN_NAME="motor_sim_demo"

# Console / serial
CONFIG_SERIAL=y
CONFIG_CONSOLE=y
CONFIG_UART_CONSOLE=y

# Logging
CONFIG_LOG=y
CONFIG_LOG_DEFAULT_LEVEL=3
CONFIG_LOG_PRINTK=n 

# Thread names (for nicer debug)
CONFIG_THREAD_NAME=y

# ZBus for inter-module messaging
CONFIG_ZBUS=y

# Shell
CONFIG_SHELL=y
CONFIG_SHELL_BACKEND_SERIAL=y
CONFIG_SHELL_LOG_BACKEND=n
CONFIG_SHELL_STACK_SIZE=2048
```

## src/main.c
```c
/**
 * @file main.c
 * @brief Application entry point.
 *
 * Initializes the application modules, starts background threads/work items,
 * and then idles forever.
 */

#include <zephyr/kernel.h>
#include <zephyr/sys/printk.h>
#include <zephyr/logging/log.h>

#include "app_state.h"
#include "motor_control.h"
#include "telemetry.h"
#include "fault_monitor.h"

LOG_MODULE_REGISTER(motor_sim_main, LOG_LEVEL_INF);

/**
 * @brief Application entry point.
 *
 * This function initializes the global application state, starts the
 * control, telemetry and fault monitor components, and then sleeps
 * forever. The motor setpoint can be adjusted at runtime using the
 * shell command:
 *
 *   motor_set <rpm>
 *
 * and the current state can be inspected with:
 *
 *   motor_info
 */
int main(void)
{
    /* Banner: single printk, everything else uses LOG_* macros. */
    printk("motor-sim-demo starting (native_sim)\n");

    int ret = app_state_init();
    if (ret != 0) {
        LOG_ERR("app_state_init failed: %d", ret);
        return ret;
    }

    motor_control_start();
    telemetry_start();
    fault_monitor_start();

    LOG_INF("Use 'motor_set <rpm>' and 'motor_info' in the shell");

    while (true) {
        k_sleep(K_SECONDS(1));
    }

    /* Not reached, but keeps the compiler happy. */
    return 0;
}
```

## src/app_state.c
```c
/**
 * @file app_state.c
 * @brief Shared motor state implementation.
 *
 * Implements the app_state module using a mutex for data protection and a
 * semaphore to signal new samples. Setpoint updates are broadcast using Zbus.
 */

#include <errno.h>

#include <zephyr/kernel.h>
#include <zephyr/zbus/zbus.h>
#include <zephyr/logging/log.h>

#include "app_state.h"

LOG_MODULE_REGISTER(app_state, LOG_LEVEL_DBG);

/* Maximum allowed setpoint, should match motor model full scale. */
#define APP_STATE_MAX_SETPOINT_RPM 10000.0f

/* Internal global state (owned by this module only). */
static struct motor_state g_state = {
    .setpoint_rpm = 1500.0f,
    .measured_rpm = 0.0f,
    .control_output_pct = 0.0f,
    .temperature_c = 25.0f,
};

/* Synchronization primitives used internally. */
static struct k_mutex state_mutex;
static struct k_sem sample_ready_sem;

/* Forward declaration of zbus listener callback. */
static void motor_state_listener_cb(const struct zbus_channel *chan);

/* Zbus listener that reacts to motor_state updates. */
ZBUS_LISTENER_DEFINE(motor_state_listener, motor_state_listener_cb);

/* Zbus channel used to broadcast motor_state updates. */
ZBUS_CHAN_DEFINE(motor_state_chan,   /* name */
                 struct motor_state, /* message type */
                 NULL,               /* validator */
                 NULL,               /* user data */
                 ZBUS_OBSERVERS(motor_state_listener),
                 ZBUS_MSG_INIT(.setpoint_rpm = 1500.0f, .measured_rpm = 0.0f,
                               .control_output_pct = 0.0f, .temperature_c = 25.0f));

/* Last setpoint value observed by the zbus listener. */
static float last_logged_setpoint = -1.0f;

/**
 * @brief Publish current state on zbus.
 *
 * This helper assumes the state mutex is already locked before calling.
 */
static void app_state_publish_locked(void)
{
    int err = zbus_chan_pub(&motor_state_chan, &g_state, K_NO_WAIT);
    if (err != 0) {
        LOG_WRN("zbus_chan_pub failed: %d", err); /* GCOVR_EXCL_LINE */
    }
}

/**
 * @brief Zbus listener callback for motor_state channel.
 *
 * This callback runs in the zbus listener context whenever a new
 * motor_state is published. Here we log setpoint changes as an example
 * of an event-driven consumer.
 */
static void motor_state_listener_cb(const struct zbus_channel *chan)
{
    const struct motor_state *msg = zbus_chan_const_msg(chan);
    /* GCOVR_EXCL_START */
    if (msg == NULL) {
        return;
    }
    /* GCOVR_EXCL_STOP */

    if (msg->setpoint_rpm != last_logged_setpoint) {
        LOG_INF("ZBUS: setpoint changed to %d rpm", (int)msg->setpoint_rpm);
        last_logged_setpoint = msg->setpoint_rpm;
    }
}

int app_state_init(void)
{
    k_mutex_init(&state_mutex);
    k_sem_init(&sample_ready_sem, 0, 1);

    k_mutex_lock(&state_mutex, K_FOREVER);
    app_state_publish_locked();
    k_mutex_unlock(&state_mutex);

    LOG_INF("app_state initialized: setpoint=%d rpm", (int)g_state.setpoint_rpm);

    return 0;
}

int app_state_set_setpoint(float rpm)
{
    if ((rpm < 0.0f) || (rpm > APP_STATE_MAX_SETPOINT_RPM)) {
        LOG_WRN("Setpoint out of range: %d rpm", (int)rpm);
        return -ERANGE;
    }

    k_mutex_lock(&state_mutex, K_FOREVER);

    g_state.setpoint_rpm = rpm;
    app_state_publish_locked();

    k_mutex_unlock(&state_mutex);

    /* No LOG_INF here: the zbus listener logs setpoint changes. */
    return 0;
}

int app_state_update_feedback(float measured_rpm, float control_output_pct, float temperature_c)
{
    k_mutex_lock(&state_mutex, K_FOREVER);

    g_state.measured_rpm = measured_rpm;
    g_state.control_output_pct = control_output_pct;
    g_state.temperature_c = temperature_c;

    app_state_publish_locked();

    /* Notify listeners (e.g. telemetry) there is a new sample. */
    k_sem_give(&sample_ready_sem);

    k_mutex_unlock(&state_mutex);

    return 0;
}

int app_state_get_snapshot(struct motor_state *out)
{
    if (out == NULL) {
        LOG_ERR("app_state_get_snapshot: out is NULL");
        return -EINVAL;
    }

    k_mutex_lock(&state_mutex, K_FOREVER);
    *out = g_state;
    k_mutex_unlock(&state_mutex);

    return 0;
}

int app_state_wait_for_sample(void)
{
    int ret = k_sem_take(&sample_ready_sem, K_FOREVER);
    if (ret != 0) {
        LOG_ERR("k_sem_take failed: %d", ret); /* GCOVR_EXCL_LINE */
    }

    return ret;
}
```

## src/app_state.h
```c
/**
 * @file app_state.h
 * @brief Public API for the shared motor state.
 *
 * The app_state module owns the global motor state and exposes a small API to
 * update and read it. It also provides a sample-ready synchronization
 * primitive used by other threads.
 */

#ifndef APP_STATE_H_
#define APP_STATE_H_

#include <zephyr/kernel.h>

/**
 * @brief Global motor state snapshot.
 *
 * All values are represented in physical units (rpm, °C, percent).
 * This struct is owned and updated by the app_state module.
 */
struct motor_state {
    float setpoint_rpm;       /**< Target speed in rpm. */
    float measured_rpm;       /**< Simulated measured speed in rpm. */
    float control_output_pct; /**< Control output in percent (0..100). */
    float temperature_c;      /**< Simulated motor temperature in °C. */
};

/**
 * @brief Initialize the motor state and synchronization primitives.
 *
 * This must be called once at startup before any other app_state_* API
 * is used. It sets reasonable defaults and publishes the initial state.
 *
 * @return 0 on success, negative errno on error.
 */
int app_state_init(void);

/**
 * @brief Update the motor speed setpoint.
 *
 * Performs basic range validation on the requested setpoint.
 *
 * @param rpm New setpoint in rpm.
 *
 * @return 0 on success, -ERANGE if out of allowed range.
 */
int app_state_set_setpoint(float rpm);

/**
 * @brief Update measured values (feedback) from the control loop.
 *
 * This function is typically called by the motor control thread after
 * each control step. It updates the measured rpm, control output and
 * temperature in a thread-safe way, publishes the state on zbus, and
 * signals that a new sample is available for telemetry.
 *
 * @param measured_rpm       Simulated measured speed in rpm.
 * @param control_output_pct Control output in percent (0..100).
 * @param temperature_c      Simulated motor temperature in °C.
 *
 * @return 0 on success, negative errno on error.
 */
int app_state_update_feedback(float measured_rpm, float control_output_pct, float temperature_c);

/**
 * @brief Get a snapshot of the current motor state.
 *
 * @param out Pointer to a motor_state struct to fill with a copy of the
 *            current state. Must not be NULL.
 *
 * @return 0 on success, -EINVAL if out is NULL.
 */
int app_state_get_snapshot(struct motor_state *out);

/**
 * @brief Block until a new sample is available.
 *
 * This is intended for threads such as telemetry that want to react
 * whenever the control loop publishes a new feedback sample.
 *
 * @return 0 on success, negative errno on error.
 */
int app_state_wait_for_sample(void);

#endif /* APP_STATE_H_ */
```

## src/console_shell.c
```c
/**
 * @file console_shell.c
 * @brief Shell command handlers.
 *
 * Registers shell commands used by the demo to set the target speed and print
 * the current motor state.
 */

#include <stdlib.h>
#include <errno.h>

#include <zephyr/shell/shell.h>
#include <zephyr/logging/log.h>

#include "app_state.h"

LOG_MODULE_REGISTER(console_shell, LOG_LEVEL_INF);

/**
 * @brief Shell command: set motor speed setpoint.
 *
 * Usage:
 *   motor_set <rpm>
 */
static int cmd_motor_set(const struct shell *shell, size_t argc, char **argv)
{
    if (argc != 2) {
        shell_print(shell, "Usage: motor_set <rpm>");
        return -EINVAL;
    }

    char *end = NULL;
    long rpm_long = strtol(argv[1], &end, 10);

    if ((argv[1] == end) || (*end != '\0')) {
        shell_error(shell, "Invalid rpm value: %s", argv[1]);
        return -EINVAL;
    }

    if (rpm_long < 0) {
        shell_error(shell, "rpm must be non-negative");
        return -ERANGE;
    }

    float rpm = (float)rpm_long;

    int ret = app_state_set_setpoint(rpm);
    if (ret == -ERANGE) {
        shell_error(shell, "rpm out of allowed range");
        return ret;
    } else if (ret != 0) {
        shell_error(shell, "Failed to set setpoint (err=%d)", ret); /* GCOVR_EXCL_LINE */
        return ret;                                                 /* GCOVR_EXCL_LINE */
    }

    shell_print(shell, "Setpoint set to %ld rpm", rpm_long);
    LOG_INF("Shell: motor_set %ld rpm", rpm_long);

    return 0;
}

/**
 * @brief Shell command: print current motor state snapshot.
 *
 * Usage:
 *   motor_info
 */
static int cmd_motor_info(const struct shell *shell, size_t argc, char **argv)
{
    ARG_UNUSED(argc);
    ARG_UNUSED(argv);

    struct motor_state state;
    int ret = app_state_get_snapshot(&state);
    if (ret != 0) {
        shell_error(shell, "Failed to get motor state (err=%d)", ret); /* GCOVR_EXCL_LINE */
        return ret;                                                    /* GCOVR_EXCL_LINE */
    }

    shell_print(shell,
                "SP=%d rpm, MEAS=%d rpm, OUT=%d%%, T=%d C",
                (int)state.setpoint_rpm,
                (int)state.measured_rpm,
                (int)state.control_output_pct,
                (int)state.temperature_c);

    return 0;
}

/* Register shell commands. */
SHELL_CMD_REGISTER(motor_set, NULL, "Set motor speed setpoint (rpm)", cmd_motor_set);

SHELL_CMD_REGISTER(motor_info, NULL, "Print current motor state snapshot", cmd_motor_info);
```

## src/fault_monitor.c
```c
/**
 * @file fault_monitor.c
 * @brief Fault monitor work item implementation.
 *
 * Implements a delayable work handler that periodically evaluates
 * speed/temperature conditions and logs faults.
 */

#include <zephyr/kernel.h>
#include <zephyr/logging/log.h>

#include "fault_monitor.h"
#include "app_state.h"

LOG_MODULE_REGISTER(fault_monitor, LOG_LEVEL_INF);

/** Period of the fault monitor work item. */
#ifdef MOTOR_SIM_DEMO_UNIT_TEST
#define FAULT_MONITOR_PERIOD K_MSEC(20)
#else
#define FAULT_MONITOR_PERIOD K_SECONDS(2)
#endif

/** Absolute speed error threshold (RPM). */
#define FAULT_SPEED_ERROR_RPM 300.0f

/** Soft temperature threshold (Celsius). */
#define SOFT_LIMIT_TEMP_C 60.0f

/** Hard temperature threshold (Celsius). */
#define HARD_LIMIT_TEMP_C 70.0f

/** Fault logs interval (msecs). */
#ifdef MOTOR_SIM_DEMO_UNIT_TEST
#define FAULT_LOG_PERIOD_MS 0
#else
#define FAULT_LOG_PERIOD_MS 10000
#endif

/**
 * @brief Internal fault monitor context.
 *
 * Holds the delayable work item and the thresholds used for evaluation.
 */
struct fault_monitor_ctx {
    /** Delayable work item used for periodic checks. */
    struct k_work_delayable dwork;
    /** Speed error threshold in RPM. */
    float speed_error_threshold_rpm;
    /** Soft temperature threshold in Celsius. */
    float soft_temp_threshold_c;
    /** Hard temperature threshold in Celsius. */
    float hard_temp_threshold_c;
    /** Last time a fault was logged (ms since boot). */
    int64_t last_log_ms;
    int64_t log_period_ms;
    uint32_t last_fault_flags;
};

/** Single static context for the demo. */
static struct fault_monitor_ctx fault_ctx = {
    .speed_error_threshold_rpm = FAULT_SPEED_ERROR_RPM,
    .soft_temp_threshold_c = SOFT_LIMIT_TEMP_C,
    .hard_temp_threshold_c = HARD_LIMIT_TEMP_C,
    .last_log_ms = 0,
    .log_period_ms = FAULT_LOG_PERIOD_MS,
    .last_fault_flags = FAULT_NONE,
};

/**
 * @brief Evaluate fault flags for a given motor state snapshot.
 *
 * This helper is used by the periodic work handler. It is also unit-tested.
 *
 * @param state Motor state snapshot to evaluate.
 * @param speed_err_th_rpm Speed error threshold in RPM (absolute diff).
 * @param soft_temp_c Soft temperature threshold in Celsius.
 * @param hard_temp_c Hard temperature threshold in Celsius.
 *
 * @return Bitmask of @ref fault_flags.
 */
uint32_t fault_monitor_eval(const struct motor_state *state, float speed_err_th_rpm,
                            float soft_temp_c, float hard_temp_c)
{
    uint32_t flags = FAULT_NONE;

    float speed_diff = state->setpoint_rpm - state->measured_rpm;
    if (speed_diff < 0.0f) {
        speed_diff = -speed_diff;
    }

    if (speed_diff > speed_err_th_rpm) {
        flags |= FAULT_SPEED_ERROR;
    }

    if (state->temperature_c > hard_temp_c) {
        flags |= FAULT_TEMP_HARD;
    } else if (state->temperature_c > soft_temp_c) {
        flags |= FAULT_TEMP_SOFT;
    }

    return flags;
}

static void fault_monitor_process(struct fault_monitor_ctx *ctx, const struct motor_state *state,
                                  int64_t now_ms)
{
    uint32_t flags = fault_monitor_eval(state,
                                        ctx->speed_error_threshold_rpm,
                                        ctx->soft_temp_threshold_c,
                                        ctx->hard_temp_threshold_c);

    ctx->last_fault_flags = flags;

    if (flags == FAULT_NONE) {
        return;
    }

    if ((now_ms - ctx->last_log_ms) < ctx->log_period_ms) {
        return;
    }

    /* Speed fault can be reported together with temp faults. */
    if (flags & FAULT_SPEED_ERROR) {
        float diff = state->setpoint_rpm - state->measured_rpm;
        if (diff < 0.0f) {
            diff = -diff;
        }
        LOG_WRN("Fault(speed): |SP-MEAS|=%d rpm (OUT=%d%%, T=%d C)",
                (int)diff,
                (int)state->control_output_pct,
                (int)state->temperature_c);
    }

    /* If HARD is active, do not show SOFT. */
    if (flags & FAULT_TEMP_HARD) {
        LOG_ERR("Fault(temp hard): T=%d C (OUT=%d%%, SP=%d rpm)",
                (int)state->temperature_c,
                (int)state->control_output_pct,
                (int)state->setpoint_rpm);
    } else if (flags & FAULT_TEMP_SOFT) {
        LOG_WRN("Fault(temp soft): T=%d C (OUT=%d%%, SP=%d rpm)",
                (int)state->temperature_c,
                (int)state->control_output_pct,
                (int)state->setpoint_rpm);
    }

    ctx->last_log_ms = now_ms;
}
/**
 * @brief Periodic work handler that checks and logs fault conditions.
 *
 * @param work Base work pointer from the workqueue.
 */
static void fault_monitor_work_handler(struct k_work *work)
{
    struct k_work_delayable *dwork = k_work_delayable_from_work(work);
    struct fault_monitor_ctx *ctx = CONTAINER_OF(dwork, struct fault_monitor_ctx, dwork);

    struct motor_state state;
    int ret = app_state_get_snapshot(&state);
    if (ret != 0) {
        LOG_ERR("fault_monitor: app_state_get_snapshot failed: %d", ret); /* GCOVR_EXCL_LINE */
        goto reschedule;                                                  /* GCOVR_EXCL_LINE */
    }

    fault_monitor_process(ctx, &state, k_uptime_get());

reschedule:
    (void)k_work_reschedule(&ctx->dwork, FAULT_MONITOR_PERIOD);
}

void fault_monitor_start(void)
{
    k_work_init_delayable(&fault_ctx.dwork, fault_monitor_work_handler);
    (void)k_work_schedule(&fault_ctx.dwork, FAULT_MONITOR_PERIOD);
    LOG_INF("Fault monitor scheduled");
}

#ifdef MOTOR_SIM_DEMO_UNIT_TEST
void fault_monitor_stop(void)
{
    (void)k_work_cancel_delayable(&fault_ctx.dwork);
}
uint32_t fault_monitor_test_process(const struct motor_state *state, int64_t now_ms)
{
    extern struct fault_monitor_ctx fault_ctx; /* o el nombre real de tu ctx global */
    fault_monitor_process(&fault_ctx, state, now_ms);
    return fault_ctx.last_fault_flags;
}

void fault_monitor_test_set_log_period_ms(int64_t ms)
{
    extern struct fault_monitor_ctx fault_ctx;
    fault_ctx.log_period_ms = ms;
}

void fault_monitor_test_set_last_log_ms(int64_t ms)
{
    extern struct fault_monitor_ctx fault_ctx;
    fault_ctx.last_log_ms = ms;
}
#endif
```

## src/fault_monitor.h
```c
/**
 * @file fault_monitor.h
 * @brief Public API for fault monitoring.
 *
 * The fault_monitor module periodically evaluates a motor state snapshot and
 * logs fault conditions.
 */

#ifndef FAULT_MONITOR_H_
#define FAULT_MONITOR_H_

#include <stdint.h>

/**
 * @brief Fault flags reported by the fault monitor.
 *
 * These flags are used in production code (work handler) and in unit tests.
 */
enum fault_flags {
    /** No fault condition. */
    FAULT_NONE = 0,
    /** Absolute speed error exceeds threshold. */
    FAULT_SPEED_ERROR = (1u << 0),
    /** Temperature exceeds soft limit. */
    FAULT_TEMP_SOFT = (1u << 1),
    /** Temperature exceeds hard limit. */
    FAULT_TEMP_HARD = (1u << 2),
};

/**
 * @brief Start the periodic fault monitor.
 *
 * Initializes and schedules a delayable work item that periodically checks:
 * - absolute speed error
 * - soft temperature limit
 * - hard temperature limit
 *
 * The monitor logs warnings/errors based on the evaluated flags.
 */
void fault_monitor_start(void);

/* -------------------------------------------------------------------------- */
/* Unit-test API                                                               */
/* -------------------------------------------------------------------------- */
/*
 * We keep the public (production) header small. The evaluation function is
 * declared only for unit tests, but it is implemented and used internally by
 * fault_monitor.c in production as well (no need for a public prototype).
 */
#ifdef MOTOR_SIM_DEMO_UNIT_TEST

#include "app_state.h" /* for struct motor_state */

/**
 * @brief Evaluate fault flags for a given motor state snapshot.
 *
 * This is a pure helper (no Zephyr calls) and is unit-testable.
 *
 * @param state Motor state snapshot to evaluate.
 * @param speed_err_th_rpm Speed error threshold in RPM (absolute diff).
 * @param soft_temp_c Soft temperature threshold in Celsius.
 * @param hard_temp_c Hard temperature threshold in Celsius.
 *
 * @return Bitmask of @ref fault_flags.
 */
uint32_t fault_monitor_eval(const struct motor_state *state, float speed_err_th_rpm,
                            float soft_temp_c, float hard_temp_c);

/** @brief Stop fault monitor work (test-only helper). */
void fault_monitor_stop(void);
uint32_t fault_monitor_test_process(const struct motor_state *state, int64_t now_ms);
void fault_monitor_test_set_log_period_ms(int64_t ms);
void fault_monitor_test_set_last_log_ms(int64_t ms);

#endif /* MOTOR_SIM_DEMO_UNIT_TEST */

#endif /* FAULT_MONITOR_H_ */
```

## src/motor_control.c
```c
/**
 * @file motor_control.c
 * @brief Motor control loop implementation.
 *
 * Implements the periodic control thread and a simple motor/temperature model
 * used by the demo.
 */

#include <zephyr/kernel.h>
#include <zephyr/logging/log.h>

#include "app_state.h"
#include "motor_control.h"

LOG_MODULE_REGISTER(motor_control, LOG_LEVEL_DBG);

#define CONTROL_THREAD_STACK_SIZE 1024
#define CONTROL_THREAD_PRIORITY   2

#define CONTROL_PERIOD_MS 50

#define MOTOR_MAX_RPM     10000.0f
#define AMBIENT_TEMP_C    25.0f
#define MAX_TEMP_C        130.0f
#define SOFT_LIMIT_TEMP_C 80.0f
#define HARD_LIMIT_TEMP_C 100.0f

/* Heat / cooling and dynamic response tuning constants. */
#define TEMP_NORM_RPM      4000.0f
#define COOL_GAIN          0.02f
#define HEAT_GAIN          (COOL_GAIN * 50.0f) /* 1.0f */
#define SPEED_FILTER_ALPHA 0.2f
#define KP_PERCENT         10.0f /* proportional effect as % of full output */

#define MOTOR_CONTROL_THREAD_NAME "motor_ctrl"

static void control_thread(void *p1, void *p2, void *p3);

K_THREAD_STACK_DEFINE(control_stack, CONTROL_THREAD_STACK_SIZE);
static struct k_thread control_thread_data;
static k_tid_t control_tid;

void motor_control_start(void)
{
    control_tid = k_thread_create(&control_thread_data,
                                  control_stack,
                                  K_THREAD_STACK_SIZEOF(control_stack),
                                  control_thread,
                                  NULL,
                                  NULL,
                                  NULL,
                                  CONTROL_THREAD_PRIORITY,
                                  0,
                                  K_NO_WAIT);

    (void)k_thread_name_set(control_tid, MOTOR_CONTROL_THREAD_NAME);

    LOG_INF("Thread '%s' started (tid=%p)", MOTOR_CONTROL_THREAD_NAME, (void *)control_tid);
}

void motor_control_step(struct motor_state *state)
{
    /* Simple proportional control based on speed error. */
    float error = state->setpoint_rpm - state->measured_rpm;

    float step_pct = (error / MOTOR_MAX_RPM) * KP_PERCENT;
    state->control_output_pct += step_pct;

    if (state->control_output_pct < 0.0f) {
        state->control_output_pct = 0.0f;
    } else if (state->control_output_pct > 100.0f) {
        state->control_output_pct = 100.0f;
    }

    /* First order motor model: measured_rpm moves towards target_rpm. */
    float target_rpm = (state->control_output_pct / 100.0f) * MOTOR_MAX_RPM;
    state->measured_rpm += (target_rpm - state->measured_rpm) * SPEED_FILTER_ALPHA;

    /* Temperature normalization model */
    float speed_norm = state->measured_rpm / TEMP_NORM_RPM;
    if (speed_norm < 0.0f) {
        speed_norm = -speed_norm;
    }
    if (speed_norm > 1.0f) {
        speed_norm = 1.0f;
    }

    float heating = HEAT_GAIN * speed_norm * speed_norm;
    float cooling = COOL_GAIN * (state->temperature_c - AMBIENT_TEMP_C);
    state->temperature_c += (heating - cooling);

    if (state->temperature_c < AMBIENT_TEMP_C) {
        state->temperature_c = AMBIENT_TEMP_C;
    }
    if (state->temperature_c > MAX_TEMP_C) {
        state->temperature_c = MAX_TEMP_C;
    }

    /* Temperature-based saturation (safety), actual fault reporting is separate. */
    if ((state->temperature_c > SOFT_LIMIT_TEMP_C) && (state->control_output_pct > 60.0f)) {
        state->control_output_pct = 60.0f;
    }

    if ((state->temperature_c > HARD_LIMIT_TEMP_C) && (state->control_output_pct > 10.0f)) {
        state->control_output_pct = 10.0f;
    }
}

/**
 * @brief Main motor control loop.
 *
 * This thread:
 * - reads the current setpoint and feedback,
 * - computes a simple proportional correction,
 * - simulates first-order motor dynamics,
 * - updates temperature and applies overtemperature limits (saturation),
 * - publishes feedback back to app_state.
 */
static void control_thread(void *p1, void *p2, void *p3)
{
    ARG_UNUSED(p1);
    ARG_UNUSED(p2);
    ARG_UNUSED(p3);

    while (true) {
        struct motor_state state;
        int ret = app_state_get_snapshot(&state);
        /* GCOVR_EXCL_START */
        if (ret != 0) {
            LOG_ERR("T[%s] app_state_get_snapshot failed: %d", MOTOR_CONTROL_THREAD_NAME, ret);
            k_msleep(CONTROL_PERIOD_MS);
            continue;
        }
        /* GCOVR_EXCL_STOP */

        motor_control_step(&state);

        ret = app_state_update_feedback(
            state.measured_rpm, state.control_output_pct, state.temperature_c);
        /* GCOVR_EXCL_START */
        if (ret != 0) {
            LOG_ERR("T[%s] app_state_update_feedback failed: %d", MOTOR_CONTROL_THREAD_NAME, ret);
        }
        /* GCOVR_EXCL_STOP */

        k_msleep(CONTROL_PERIOD_MS);
    }
}

#ifdef MOTOR_SIM_DEMO_UNIT_TEST
void motor_control_stop(void)
{
    if (control_tid != NULL) {
        k_thread_abort(control_tid);
        control_tid = NULL;
    }
}
#endif
```

## src/motor_control.h
```c
/**
 * @file motor_control.h
 * @brief Public API for the motor control loop.
 *
 * The motor_control module runs a periodic control loop that updates the motor
 * output to follow a setpoint. In unit tests, a pure step function is exposed
 * to allow deterministic testing.
 */

#ifndef MOTOR_CONTROL_H_
#define MOTOR_CONTROL_H_

/**
 * @brief Start the motor control thread.
 *
 * This creates a dedicated thread that periodically:
 * - reads the motor state,
 * - updates the control output to follow the setpoint,
 * - simulates motor dynamics and temperature,
 * - writes feedback back into the shared state.
 */
void motor_control_start(void);

#ifdef MOTOR_SIM_DEMO_UNIT_TEST
#include "app_state.h"

/**
 * @brief Run a single control-loop step on a state snapshot (test-only).
 *
 * This function implements the pure control + model update logic without any
 * threading, sleeps, or synchronization. It is intended for deterministic unit tests.
 *
 * @param state In/out motor state snapshot to be updated.
 */
void motor_control_step(struct motor_state *state);

/**
 * @brief Stop the motor control thread (test-only).
 *
 * Aborts the internal thread created by @ref motor_control_start.
 */
void motor_control_stop(void);
#endif /* MOTOR_SIM_DEMO_UNIT_TEST */

#endif /* MOTOR_CONTROL_H_ */
```

## src/telemetry.c
```c
/**
 * @file telemetry.c
 * @brief Telemetry thread implementation.
 *
 * Implements a telemetry thread that waits for new samples from app_state and
 * logs a snapshot every N samples.
 */

#include <zephyr/kernel.h>
#include <zephyr/logging/log.h>

#include "app_state.h"
#include "telemetry.h"

LOG_MODULE_REGISTER(telemetry, LOG_LEVEL_DBG);

#define TELEMETRY_THREAD_STACK_SIZE 1024
#define TELEMETRY_THREAD_PRIORITY   3

#define TELEMETRY_THREAD_NAME "telemetry"

static void telemetry_thread(void *p1, void *p2, void *p3);

K_THREAD_STACK_DEFINE(telemetry_stack, TELEMETRY_THREAD_STACK_SIZE);
static struct k_thread telemetry_thread_data;
static k_tid_t telemetry_tid;

void telemetry_start(void)
{
    telemetry_tid = k_thread_create(&telemetry_thread_data,
                                    telemetry_stack,
                                    K_THREAD_STACK_SIZEOF(telemetry_stack),
                                    telemetry_thread,
                                    NULL,
                                    NULL,
                                    NULL,
                                    TELEMETRY_THREAD_PRIORITY,
                                    0,
                                    K_NO_WAIT);

    (void)k_thread_name_set(telemetry_tid, TELEMETRY_THREAD_NAME);

    LOG_INF("Thread '%s' started (tid=%p)", TELEMETRY_THREAD_NAME, (void *)telemetry_tid);
}

bool telemetry_should_log(int *counter)
{
    (*counter)++;
    return ((*counter % 10) == 0);
}

/**
 * @brief Telemetry loop.
 *
 * This thread blocks until app_state signals that a new sample is
 * available, then logs a snapshot of the current motor state every
 * N samples to avoid flooding the log output.
 */
static void telemetry_thread(void *p1, void *p2, void *p3)
{
    ARG_UNUSED(p1);
    ARG_UNUSED(p2);
    ARG_UNUSED(p3);

    int counter = 0;

    while (true) {
        int ret = app_state_wait_for_sample();
        /* GCOVR_EXCL_START */
        if (ret != 0) {
            LOG_ERR("T[%s] app_state_wait_for_sample failed: %d", TELEMETRY_THREAD_NAME, ret);
            continue;
        }
        /* GCOVR_EXCL_STOP */

        /* Reduce log volume by printing every 10th sample. */
        if (!telemetry_should_log(&counter)) {
            continue;
        }

        struct motor_state state;
        ret = app_state_get_snapshot(&state);
        /* GCOVR_EXCL_START */
        if (ret != 0) {
            LOG_ERR("T[%s] app_state_get_snapshot failed: %d", TELEMETRY_THREAD_NAME, ret);
            continue;
        }
        /* GCOVR_EXCL_STOP */

        LOG_INF("T[%s] SP=%d rpm, MEAS=%d rpm, OUT=%d%%, T=%d C",
                TELEMETRY_THREAD_NAME,
                (int)state.setpoint_rpm,
                (int)state.measured_rpm,
                (int)state.control_output_pct,
                (int)state.temperature_c);
    }
}

#ifdef MOTOR_SIM_DEMO_UNIT_TEST
void telemetry_stop(void)
{
    if (telemetry_tid != NULL) {
        k_thread_abort(telemetry_tid);
        telemetry_tid = NULL;
    }
}
#endif
```

## src/telemetry.h
```c
/**
 * @file telemetry.h
 * @brief Public API for telemetry logging.
 *
 * The telemetry module runs a thread that waits for new samples and
 * periodically logs a motor state snapshot.
 */

#ifndef TELEMETRY_H_
#define TELEMETRY_H_

/**
 * @brief Start the telemetry thread.
 *
 * The telemetry thread waits for new samples from app_state and
 * periodically logs a snapshot of the current motor state.
 */
void telemetry_start(void);

#ifdef MOTOR_SIM_DEMO_UNIT_TEST
#include <stdbool.h>

/**
 * @brief Decide whether telemetry should log on this sample (test-only).
 *
 * The internal sample counter is incremented and the function returns true
 * every 10th call (i.e., when the counter is divisible by 10).
 *
 * @param counter Pointer to a persistent counter variable.
 * @return true if this call corresponds to a log event, false otherwise.
 */
bool telemetry_should_log(int *counter);

/**
 * @brief Stop the telemetry thread (test-only).
 *
 * Aborts the internal thread created by @ref telemetry_start.
 */
void telemetry_stop(void);
#endif /* MOTOR_SIM_DEMO_UNIT_TEST */

#endif /* TELEMETRY_H_ */
```
