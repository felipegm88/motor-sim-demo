## tests/integration/system/testcase.yaml
```yaml
tests:
  motor_sim_demo.integration.system:
    platform_allow: native_sim
    tags: motor_sim_demo integration
    harness: ztest
```

## tests/unit/app_state/testcase.yaml
```yaml
tests:
  motor_sim_demo.unit.app_state:
    platform_allow: native_sim
    tags: motor_sim_demo unit app_state
    harness: ztest
```

## tests/unit/console_shell/testcase.yaml
```yaml
tests:
  motor_sim_demo.unit.console_shell:
    platform_allow: native_sim
    tags: motor_sim_demo unit console_shell
    harness: ztest
```

## tests/unit/fault_monitor/testcase.yaml
```yaml
tests:
  motor_sim_demo.unit.fault_monitor:
    platform_allow: native_sim
    tags: motor_sim_demo unit fault_monitor
    harness: ztest
```

## tests/unit/motor_control/testcase.yaml
```yaml
tests:
  motor_sim_demo.unit.motor_control:
    platform_allow: native_sim
    tags: motor_sim_demo unit motor_control
    harness: ztest
```

## tests/unit/telemetry/testcase.yaml
```yaml
tests:
  motor_sim_demo.unit.telemetry:
    platform_allow: native_sim
    tags: motor_sim_demo unit telemetry
    harness: ztest
```
