## CMakeLists.txt
```
cmake_minimum_required(VERSION 3.20.0)

find_package(Zephyr REQUIRED HINTS $ENV{ZEPHYR_BASE})
project(motor_sim_demo_unit_console_shell)

target_sources(app PRIVATE
  src/test_console_shell.c
  ../../../src/app_state.c
  ../../../src/console_shell.c
)

target_include_directories(app PRIVATE
  ${CMAKE_CURRENT_LIST_DIR}/../../../src
)

target_compile_definitions(app PRIVATE MOTOR_SIM_DEMO_UNIT_TEST=1)
```

## prj.conf
```kconfig
CONFIG_ZTEST=y

CONFIG_ZBUS=y
CONFIG_LOG=y
CONFIG_LOG_DEFAULT_LEVEL=0

CONFIG_SHELL=y
CONFIG_SHELL_BACKEND_DUMMY=y
CONFIG_SHELL_BACKEND_SERIAL=n
```

## src/test_console_shell.c
```c
#include <errno.h>

#include <zephyr/ztest.h>
#include <zephyr/shell/shell.h>

#include "app_state.h"

static void reset_state(void)
{
    zassert_equal(app_state_init(), 0, NULL);
}

ZTEST(console_shell, test_motor_set_valid)
{
    reset_state();

    int ret = shell_execute_cmd(NULL, "motor_set 1234");
    zassert_equal(ret, 0, NULL);

    struct motor_state s;
    zassert_equal(app_state_get_snapshot(&s), 0, NULL);
    zassert_true(s.setpoint_rpm == 1234.0f, NULL);
}

ZTEST(console_shell, test_motor_set_out_of_range)
{
    reset_state();

    int ret = shell_execute_cmd(NULL, "motor_set 999999");
    zassert_equal(ret, -ERANGE, NULL);
}

ZTEST(console_shell, test_motor_set_missing_arg)
{
    reset_state();

    int ret = shell_execute_cmd(NULL, "motor_set");
    zassert_equal(ret, -EINVAL, NULL);
}

ZTEST(console_shell, test_motor_set_bad_arg)
{
    reset_state();

    int ret = shell_execute_cmd(NULL, "motor_set abc");
    zassert_equal(ret, -EINVAL, NULL);
}

ZTEST(console_shell, test_motor_info_smoke)
{
    reset_state();

    int ret = shell_execute_cmd(NULL, "motor_info");
    zassert_equal(ret, 0, NULL);
}

ZTEST(console_shell, test_motor_set_negative)
{
    reset_state();
    int ret = shell_execute_cmd(NULL, "motor_set -1");
    zassert_equal(ret, -ERANGE, NULL);
}

ZTEST(console_shell, test_motor_set_extra_arg)
{
    reset_state();
    int ret = shell_execute_cmd(NULL, "motor_set 10 20");
    zassert_equal(ret, -EINVAL, NULL);
}

ZTEST_SUITE(console_shell, NULL, NULL, NULL, NULL, NULL);
```
